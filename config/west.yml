## config/west.yml
```yaml
manifest:
  remotes:
    - name: zmkfirmware
      url-base: https://github.com/burakcan
  projects:
    - name: zmk
      remote: zmkfirmware
      revision: Board-Corne-ish-Zen-dedicated-work-queue
      import: app/west.yml
  self:
    path: config
```
